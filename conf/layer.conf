## conf/layer.conf
```bitbake
# We have a conf and classes directory, add to BBPATH
BBPATH .= ":${LAYERDIR}"

# We have recipes-* directories, add to BBFILES
BBFILES += "${LAYERDIR}/recipes-*/*/*.bb \
	    ${LAYERDIR}/recipes-*/*/*.bbappend"

BBFILE_COLLECTIONS += "meta-doom"
BBFILE_PATTERN_meta-doom = "^${LAYERDIR}/"
BBFILE_PRIORITY_meta-doom = "6"

LAYERDEPENDS_meta-doom = "core freescale-layer"
```
